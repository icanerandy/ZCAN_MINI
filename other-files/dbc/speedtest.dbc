VERSION "SingleFrame1.dbc"

NS_ :

BS_:

BU_: TestNode

BO_ 123 Speed: 8 TestNode
	SG_ refSpeed : 0|8@1+ (1,0) [0|0] "km/s" Vector__XXX
	SG_ relSpeed : 0|8@1+ (1,0) [0|0] "km/s" Vector__XXX

CM_ BO_ 123 "test msg";
CM_ SG_ 123 speed "speed";
