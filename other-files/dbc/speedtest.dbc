VERSION ""

NS_ :

BS_:

BU_: Vector__XXX

BO_ 123 Speed: 8 Vector__XXX
	SG_ refSpeed : 0|8@1+ (1,0) [0|0] "km/s" Vector__XXX
	SG_ relSpeed : 0|8@1+ (1,0) [0|0] "km/s" Vector__XXX

CM_ BO_ 123 "test msg";
CM_ SG_ 123 refSpeed "refSpeed";
CM_ SG_ 123 relSpeed "relSpeed";
