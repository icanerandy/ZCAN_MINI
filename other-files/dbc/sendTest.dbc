VERSION ""

NS_ :

BS_:

BU_:

BO_ 3221225472 VECTOR__INDEPENDENT_SIG_MSG: 0 Vector__XXX
 SG_ motor_Command : 0|8@1- (1,0) [0|0] "" Vector__XXX
 SG_ pwm3 : 0|16@1- (1,0) [0|0] "" Vector__XXX
 SG_ pwm2 : 0|16@1- (1,0) [0|0] "" Vector__XXX

BO_ 261 Nonlinear_Obs: 8 Vector__XXX

BO_ 260 hfi: 32 Vector__XXX

BO_ 259 smo: 8 Vector__XXX

BO_ 258 foc: 48 Vector__XXX
 SG_ sendCount : 192|32@1- (1,0) [-2147483648|2147483647] "" Vector__XXX
 SG_ bit32_5 : 352|32@1- (1,0) [0|0] "" Vector__XXX
 SG_ bit32_4 : 320|32@1- (1,0) [0|0] "" Vector__XXX
 SG_ bit32_3 : 288|32@1- (1,0) [0|0] "" Vector__XXX
 SG_ bit32_2 : 256|32@1- (1,0) [0|0] "" Vector__XXX
 SG_ bit32_1 : 224|32@1- (1,0) [0|0] "" Vector__XXX
 SG_ pwm1 : 176|16@1- (1,0) [0|0] "" Vector__XXX
 SG_ Ic : 160|16@1- (0.00390625,0) [0|0] "" Vector__XXX
 SG_ Ib : 144|16@1- (0.00390625,0) [-32.000016384|31.999039821] "" Vector__XXX
 SG_ Ia : 128|16@1- (0.00390625,0) [0|0] "" Vector__XXX
 SG_ Vbeta : 112|16@1- (0.00390625,0) [0|0] "" Vector__XXX
 SG_ Valpha : 96|16@1- (0.00390625,0) [0|0] "" Vector__XXX
 SG_ Vq : 80|16@1- (0.00390625,0) [0|0] "" Vector__XXX
 SG_ Vd : 64|16@1- (0.00390625,0) [0|0] "" Vector__XXX
 SG_ Iq : 48|16@1- (0.00390625,0) [0|0] "" Vector__XXX
 SG_ Id : 32|16@1- (0.00390625,0) [0|0] "" Vector__XXX
 SG_ Ibeta : 16|16@1- (0.00390625,0) [0|0] "" Vector__XXX
 SG_ Iapha : 0|16@1- (0.00390625,0) [0|0] "" Vector__XXX

BO_ 257 motor: 32 Vector__XXX
 SG_ motor_SetIq : 64|16@1- (0.000976563,0) [0|0] "" Vector__XXX
 SG_ motor_SetId : 48|16@1- (0.000976563,0) [0|0] "" Vector__XXX
 SG_ motor_SetTorque : 32|16@1- (0.000976563,0) [0|0] "" Vector__XXX
 SG_ motor_SetSpeed : 16|16@1- (0.000976563,0) [0|0] "" Vector__XXX
 SG_ motor_State : 0|16@1- (1,0) [0|0] "" Vector__XXX

CM_ BO_ 3221225472 "This is a message for not used signals, created by Vector CANdb++ DBC OLE DB Provider.";
BA_DEF_ BO_  "VFrameFormat" ENUM  "StandardCAN","ExtendedCAN","reserved","reserved","reserved","reserved","reserved","reserved","reserved","reserved","reserved","reserved","reserved","reserved","StandardCAN_FD","ExtendedCAN_FD";
BA_DEF_  "BusType" STRING ;
BA_DEF_DEF_  "VFrameFormat" "ExtendedCAN_FD";
BA_DEF_DEF_  "BusType" "CAN";
BA_ "BusType" "CAN FD";
BA_ "VFrameFormat" BO_ 261 14;
BA_ "VFrameFormat" BO_ 260 14;
BA_ "VFrameFormat" BO_ 259 14;
BA_ "VFrameFormat" BO_ 258 14;
BA_ "VFrameFormat" BO_ 257 14;
