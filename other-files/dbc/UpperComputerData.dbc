VERSION ""

NS_ :

BS_:

BU_:

BO_ 258 UpperComputerData: 64 Vector__XXX
 SG_ FL_PressureValue : 248|16@1+ (0.01,0) [0|655.35] "" Vector__XXX
 SG_ RR_PressureValue : 256|16@1+ (0.01,0) [0|655.35] "" Vector__XXX
 SG_ FR_PressureValue : 232|16@1+ (0.01,0) [0|655.35] "" Vector__XXX
 SG_ RL_PressureValue : 216|16@1+ (0.01,0) [0|655.35] "" Vector__XXX
 SG_ MsgSendTime : 200|16@1+ (1,0) [0|65535] "" Vector__XXX
 SG_ J_SolenoidState : 196|4@1+ (1,0) [0|15] "" Vector__XXX
 SG_ Q_SolenoidState : 192|4@1+ (1,0) [0|15] "" Vector__XXX
 SG_ R_SolenoidState : 188|4@1+ (1,0) [0|15] "" Vector__XXX
 SG_ P_SolenoidState : 184|4@1+ (1,0) [0|15] "" Vector__XXX
 SG_ O_SolenoidState : 180|4@1+ (1,0) [0|15] "" Vector__XXX
 SG_ H_SolenoidState : 176|4@1+ (1,0) [0|15] "" Vector__XXX
 SG_ J_solenoidPwmValue : 168|8@1+ (1,0) [0|255] "" Vector__XXX
 SG_ Q_solenoidPwmValue : 160|8@1+ (1,0) [0|255] "" Vector__XXX
 SG_ R_solenoidPwmValue : 152|8@1+ (1,0) [0|255] "" Vector__XXX
 SG_ P_solenoidPwmValue : 144|8@1+ (1,0) [0|255] "" Vector__XXX
 SG_ O_solenoidPwmValue : 136|8@1+ (1,0) [0|255] "" Vector__XXX
 SG_ H_solenoidPwmValue : 128|8@1+ (1,0) [0|255] "" Vector__XXX
 SG_ A_solenoidPwmValue : 120|8@1+ (1,0) [0|255] "" Vector__XXX
 SG_ E_solenoidPwmValue : 112|8@1+ (1,0) [0|255] "" Vector__XXX
 SG_ N_solenoidPwmValue : 104|8@1+ (1,0) [0|255] "" Vector__XXX
 SG_ M_solenoidPwmValue : 96|8@1+ (1,0) [0|255] "" Vector__XXX
 SG_ T_solenoidPwmValue : 88|8@1+ (1,0) [0|255] "" Vector__XXX
 SG_ D_solenoidPwmValue : 80|8@1+ (1,0) [0|255] "" Vector__XXX
 SG_ L_solenoidPwmValue : 72|8@1+ (1,0) [0|255] "" Vector__XXX
 SG_ K_solenoidPwmValue : 64|8@1+ (1,0) [0|255] "" Vector__XXX
 SG_ DisplacementValue2 : 48|16@1+ (0.01,0) [0|655.35] "" Vector__XXX
 SG_ DisplacementValue : 32|16@1+ (0.01,0) [0|655.35] "" Vector__XXX
 SG_ DisplacementPressureValue : 16|16@1+ (0.01,0) [0|655.35] "" Vector__XXX
 SG_ MotorPressureValue : 0|16@1+ (0.01,0) [0|655.35] "" Vector__XXX

BA_DEF_ BO_  "CANFD_BRS" ENUM  "0","1";
BA_DEF_  "DBName" STRING ;
BA_DEF_  "BusType" STRING ;
BA_DEF_ BO_  "VFrameFormat" ENUM  "StandardCAN","ExtendedCAN","reserved","reserved","reserved","reserved","reserved","reserved","reserved","reserved","reserved","reserved","reserved","reserved","StandardCAN_FD","ExtendedCAN_FD";
BA_DEF_DEF_  "CANFD_BRS" "1";
BA_DEF_DEF_  "DBName" "";
BA_DEF_DEF_  "BusType" "";
BA_DEF_DEF_  "VFrameFormat" "StandardCAN";
BA_ "BusType" "CAN FD";
BA_ "DBName" "UpperComputerData";
BA_ "VFrameFormat" BO_ 258 14;
